## hw/adc/Kconfig
```kconfig
config STM32F2XX_ADC
    bool

config RENESAS_ADS1263
    bool

config RENESAS_S12AD
    bool
```

## hw/rx/Kconfig
```kconfig
config RX62N_MCU
    bool
    select RX_ICU
    select RENESAS_TMR
    select RENESAS_CMT
    select RENESAS_SCI

config RX_GDBSIM
    bool
    default y
    depends on RX && FDT
    select DEVICE_TREE
    select RX62N_MCU

config RX65N_MCU
    bool
    select RX_ICU
    select RENESAS_TMR
    select RENESAS_CMT
    select RENESAS_SCI
    select RENESAS_MTU3
    select RENESAS_S12AD
    select RENESAS_RSPI
    select RENESAS_ETHERC
    select RX65N_SYSCLK
    select RENESAS_RX_FCU
    select RENESAS_RX_GPIO
    select RENESAS_RX_DMAC
    select RENESAS_RX_DTC
    select RENESAS_RX_WDT
    select RENESAS_RX_RTC
    select LED
    select UNIMP

config RX65N_EVK
    bool
    default y
    depends on RX && FDT
    select DEVICE_TREE
    select RX65N_MCU
    select SPLIT_IRQ
```
