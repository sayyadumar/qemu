## hw/avr/Kconfig
```kconfig
config AVR_ATMEGA_MCU
    bool
    select AVR_TIMER16
    select AVR_TIMER8
    select AVR_EEPROM
    select AVR_WDT
    select AVR_ADC
    select AVR_SPI
    select SSI_M25P80
    select AVR_USART
    select AVR_POWER
    select AVR_TWI

config ARDUINO
    bool
    default y
    depends on AVR
    select AVR_ATMEGA_MCU
    select UNIMP
```
